## CMakeLists.txt
```
#find Zephyr. THis also loads Zephyr's build system.
cmake_minimum_required(VERSION 3.13.1)
set(BOARD mimxrt1064_evk)
find_package(Zephyr)
project(threadapp)

include_directories(../defines)

#add sources, they must come after find_package(Zephyr)
target_sources(app PRIVATE src/main.c)
target_sources(app PRIVATE src/threads.c)
target_sources_ifdef(CONFIG_USE_USB app PRIVATE src/usb.c)
target_sources_ifdef(CONFIG_USE_CAN app PRIVATE src/peripheral_can.c)
target_sources_ifdef(CONFIG_USE_DUMMY app PRIVATE src/dummy.c)
```

## Kconfig
```
mainmenu "Kconfig Options"

menu "Project specific options"
    
config USE_CAN
    bool "Enable the CAN handlers, Note that this option currently does not work with CONFIG_USERSPACE"
    depends on USERSPACE=n
    select CAN


config USE_USB
    bool "Enable the USB handlers"
    select SERIAL
    select USB
    select USB_DEVICE_STACK
    select USB_CDC_ACM
    select UART_INTERRUPT_DRIVEN
    select UART_LINE_CTRL


config USE_DUMMY
    bool "Enable the Dummy Driver to send Messages"
    
endmenu

source "Kconfig.zephyr"
```

## west.yml
```
# The west Manifest for Threadapp.

manifest:
  defaults: 
    remote: upstream


  remotes:
    - name: upstream
      url-base: git@git.hs-mittweida.de:heisenbl
    
    - name: zephyr-rtos
      url-base: https://github.com/zephyrproject-rtos


  projects: 
    - name: defines
      revision: master
      repo-path: Defines
    
    - name: sender
      revision: master
      repo-path: Sender
    
    - name: zephyr
      revision: v2.5.0
      remote: zephyr-rtos
      import: true
  
  
  self:
    path: threadapp
```

## prj.conf
```kconfig
# Allgemein
CONFIG_ASSERT=n
CONFIG_NEWLIB_LIBC=y

# Logging
CONFIG_LOG=y
CONFIG_LOG_DEFAULT_LEVEL=3
CONFIG_LOG_MODE_MINIMAL=y

# Segger - RTT
CONFIG_UART_CONSOLE=n
CONFIG_RTT_CONSOLE=y
CONFIG_USE_SEGGER_RTT=y
CONFIG_LOG_BACKEND_UART=n
CONFIG_LOG_BACKEND_RTT=y

# Debugging
CONFIG_CONSOLE=y
CONFIG_THREAD_MONITOR=y
CONFIG_DEBUG_OPTIMIZATIONS=y

# Threads
CONFIG_USERSPACE=y
CONFIG_MAIN_STACK_SIZE=512
CONFIG_HEAP_MEM_POOL_SIZE=512

# Async
CONFIG_POLL=y
CONFIG_SPIN_VALIDATE=n

# Dummy 
CONFIG_USE_DUMMY=y

# UART 
CONFIG_USE_USB=y
CONFIG_STDOUT_CONSOLE=y
CONFIG_USB_DEVICE_PRODUCT="Zephyr Threads Example"
CONFIG_USB_DRIVER_LOG_LEVEL_ERR=y
CONFIG_USB_DEVICE_LOG_LEVEL_ERR=y

# CAN
CONFIG_USE_CAN=n
```

## src/main.c
```c
#include <zephyr.h>
#include <sys/printk.h>
#include <logging/log.h>

#include "threads.h"
#include "usb.h"
#include "peripheral_can.h"
#include "dummy.h"

LOG_MODULE_REGISTER(main);

const k_timeout_t thread_timeout = K_FOREVER;

void main(void) 
{
    LOG_INF("Main thread started");

    #ifdef CONFIG_USE_DUMMY
    dummy_recieve_to_fifo();
    #endif

    #ifdef CONFIG_USE_USB
    /* Intialize USB Peripheral */
    int ret_usb = -1;

    ret_usb = init_usb();
    if(ret_usb == -1){
        LOG_ERR("Error while setting up USB");
    }
    #endif

    #ifdef CONFIG_USE_CAN
    /* Initialize CAN Peripheral */
    int ret_can = CAN_UNITIALIZED;
    
    ret_can = init_can();
    if(ret_can == CAN_UNITIALIZED) {
        LOG_ERR("Error while setting up CAN");
    }
    #endif
}
```

## src/dummy.c
```c
#include "threads.h"
#include "message/message.h"
#include "dummy.h"
#include <logging/log.h>

LOG_MODULE_REGISTER(dummy);

void dummy_send_out(FifoMessageItem_t* fifoItem) {
    LOG_INF("DRVR: Sent out message: %s", log_strdup(fifoItem->message.text));
}

void dummy_recieve_to_fifo(void) {

    char text[10] = "helloworld";
    FifoMessageItem_t* fifoItem = createFifoMessageItem(
        0, 1000, text, dummy_send_out, NULL
    );

    k_fifo_put(&extern_to_validation, fifoItem);
    LOG_INF("DRVR: \"Recieved\" message and sent into fifo");
}
```

## src/dummy.h
```c
#ifndef DUMMY_H
#define DUMMY_H

#include "threads.h"

void dummy_send_out(FifoMessageItem_t*);

void dummy_recieve_to_fifo(void);

#endif /* DUMMY_H */
```

## src/main.h
```c
#define USE_DUMMY 1
#define USE_USB 0
#define USE_CAN 0
```

## src/peripheral_can.c
```c
#include <logging/log.h>
#include "peripheral_can.h"
#include "threads.h"
#include <device.h>
#include <drivers/can.h>

LOG_MODULE_REGISTER(peripheral_can);

/* Private Headers */
void send(FifoMessageItem_t *item);
void receive(struct zcan_frame *frame, void *arg);

const struct zcan_filter can_standard_filter = {
        .id_type = CAN_STANDARD_IDENTIFIER,
        .rtr = CAN_DATAFRAME,
        .id = 0x1,
        .rtr_mask = 1,
        .id_mask = CAN_STD_ID_MASK
};

const struct device* can_dev;
struct zcan_frame send_frame;

int init_can(void) 
{
    int filter_id;

    /* Get CAN Device */
    can_dev = device_get_binding(CAN_IDENTIFIER);
    if(can_dev == NULL) {
        LOG_ERR("No CAN device found");
        return CAN_UNITIALIZED;
    }

    if(can_set_bitrate(can_dev, 125000, 0) != 0)
        LOG_ERR("Not able to set CAN Bitrate");

    /* Attach ISR to can device */
    filter_id = can_attach_isr(can_dev, receive, NULL, &can_standard_filter);
    
    /* Logging */
    if (filter_id < 0) {
        LOG_ERR("Unable to attach can isr [%d]", filter_id);
    }

    LOG_INF("CAN ISR attached and device intialized");

    return filter_id;
}

/**
 * @brief This function gets called by the can isr when a new message
 * is received.
 * 
 * @param frame 
 * @param arg 
 */
void receive(struct zcan_frame *frame, void *arg)
{
    LOG_INF("CAN message received");

    FifoMessageItem_t* work_item = createFifoMessageItem(
        frame->data[0], frame->data[1], &frame->data[2], send, can_dev
    );

    /* Send Item to validation thread */
    k_fifo_put(&extern_to_validation, work_item);
}

/**
 * @brief This function gets called when you want to send a message
 * via CAN.
 * 
 * @param item The Message Item that has all the data needed to be send.
 */
void send(FifoMessageItem_t *item)
{
    /* Construct CAN send frame */
    send_frame.dlc = 8;
    send_frame.data[0] = item->message.priority;
    send_frame.data[1] = item->message.sleep_in_ms;

    /* Sizeof(array) minus two elements */
    strncpy(&send_frame.data[2], item->message.text, sizeof(send_frame.data) - sizeof(send_frame.data[0]) * 2);

    /* Send CAN Message */
    int ret = -1;
    ret = can_send(item->dev, &send_frame, K_MSEC(100), NULL, NULL);

    /* Log message status */
    if (ret != CAN_TX_OK) 
    {
        LOG_ERR("CAN sending failed [%d]", ret);
    }
    else 
    {
        LOG_INF("CAN send success");
    }
}
```

## src/peripheral_can.h
```c
#include <drivers/can.h>
#include "threads.h"

#define CAN_IDENTIFIER "CAN_2"
#define CAN_UNITIALIZED -1

/**
 * @brief Initializes the CAN Connection to be able to send and receive
 * messages.
 * 
 * @return int 0 on success, CAN_UNITIALIZED on error
 */
int init_can(void);
```

## src/threads.c
```c
#include <zephyr.h>
#include <kernel.h>
#include <drivers/uart.h>
#include <app_memory/mem_domain.h>
#include <logging/log.h>

#include "threads.h"

LOG_MODULE_REGISTER(threads);

/* Private headers */
void worker_thread_entry(void*, void*, void*);
void validation_thread_entry(void*, void*, void*);
void validation_thread_setup(void*, void*, void*);

/* Set up for memory management */
#ifdef CONFIG_USERSPACE
struct k_mem_domain validation_domain;
extern struct k_mem_partition v1_partition;

K_APPMEM_PARTITION_DEFINE(v1_partition);
struct k_mem_partition *validation_domain_parts[] = {
    &v1_partition
};
#endif

/* Fifo for communication between threads and ISR */
K_FIFO_DEFINE(validation_to_worker);
K_FIFO_DEFINE(extern_to_validation);

/* Validation thread poll events setup */
#define K_POLL_EVENT_AMOUNT 2
#define EXTERN_MESSAGE_INCOMING 0

K_APP_DMEM(v1_partition) struct k_poll_event events[K_POLL_EVENT_AMOUNT] = {
    K_POLL_EVENT_STATIC_INITIALIZER(K_POLL_TYPE_FIFO_DATA_AVAILABLE,
                                    K_POLL_MODE_NOTIFY_ONLY,
                                    &extern_to_validation, 0)
};

/* Setup Threads */
K_THREAD_DEFINE(v1, STACKSIZE, validation_thread_setup, NULL, NULL, NULL, COMMUNICATION_THREAD_PRIORITY, 0, 0);
K_THREAD_DEFINE(w1, STACKSIZE, worker_thread_entry, NULL, NULL, NULL,  WORKER_THREAD_PRIORITY, 0, 0);

K_HEAP_DEFINE(validation_heap, 512);
K_HEAP_DEFINE(worker_heap, 512);

/* Grant validation thread access to needed kernel objects */
K_APP_DMEM(v1_partition) K_HEAP_DEFINE(message_item_heap, sizeof(FifoMessageItem_t) * 20);
K_THREAD_ACCESS_GRANT(v1, &extern_to_validation, &validation_to_worker, &message_item_heap, &events);

/** 
 * @brief Setup for the validation thread before it enters usermode.
 */
void validation_thread_setup(void* p1, void* p2, void* p3)
{
    k_thread_heap_assign(v1, &validation_heap);
    #ifdef CONFIG_USERSPACE
    k_mem_domain_init(&validation_domain, ARRAY_SIZE(validation_domain_parts), validation_domain_parts);
    k_mem_domain_add_thread(&validation_domain, v1);
    #endif

    k_thread_user_mode_enter(validation_thread_entry, NULL, NULL, NULL);
}

/**
 * @brief The main function for a validation thread.
 * The validation thread is running in usermode.
 *
 */
void validation_thread_entry(void* p1, void* p2, void* p3) 
{
    LOG_INF("Validation thread started");

    /* Loop, der die FIFOS checkt ob neue "Ressourcen" (/Nachrichten)
       vorhanden sind, wenn ja diese abarbeiten. */
    FifoMessageItem_t *work_item;
    int poll = -1;

    while(true)
    {
        /* Reset Events for next loop .
         * By doing this here we can reduce the indentation level ins the IFs.
         */
        events[0].state = K_POLL_STATE_NOT_READY;

        /* "Poll" for new event */
        poll = k_poll(events, K_POLL_EVENT_AMOUNT, K_FOREVER);

        /* Poll again if an error happens */
        if(poll != 0)
            continue;

        /* ISR recieved a message and put it into it FIFO */
        if(events[EXTERN_MESSAGE_INCOMING].state == K_POLL_STATE_FIFO_DATA_AVAILABLE) 
        {
            LOG_INF("Received message from ISR FIFO");
            work_item = k_fifo_get(&extern_to_validation, K_MSEC(100));
            if(work_item == NULL) 
                continue;
            
            /* validate recieved message */
            if(work_item->message.sleep_in_ms > MESSAGE_MAX_SLEEP){
                LOG_ERR("Sleep_in_ms too long: %d", work_item->message.sleep_in_ms);
                work_item->message.sleep_in_ms = MESSAGE_MAX_SLEEP;
            }


            /* send to worker */
            k_fifo_alloc_put(&validation_to_worker, work_item);
            LOG_DBG("Put FifoMessageItem into validation_to_worker queue");
        }
    }
}

/**
 * @brief The main function for a worker thread.
 * 
 */
void worker_thread_entry(void* p1, void* p2, void* p3) 
{
    LOG_INF("Worker thread started");

    k_thread_heap_assign(w1, &worker_heap);
    struct FifoMessageItem *item;

    while(true) 
    {
        /* Wait for new can message from validation thread */
        item = k_fifo_get(&validation_to_worker, K_FOREVER);

        /* Process Message */
        k_msleep(item->message.sleep_in_ms);
        reverse_in_place(item->message.text, sizeof(item->message.text));

        /* Send message and free it from heap */
        item->send(item);
        LOG_DBG("Sent item: {%d, %d, %s}", item->message.priority, item->message.sleep_in_ms, log_strdup(item->message.text));
        k_heap_free(&message_item_heap, item);
        LOG_INF("Send Message to extern and erased item from heap");
    }
}

void reverse_in_place(char* text, size_t length) 
{
    /* find real length */
    for(int i = 0; i < length; i++){
        if(text[i] == '\0'){
            length = i;
        }
    }

    int len = length - 1;
    char tmp;
    /* Swap characters */
    for (int i = 0; i < length / 2; i++) 
    {
        tmp = text[i];
        text[i] = text[len];
        text[len--] = tmp;
    }

    return;
}

FifoMessageItem_t* createFifoMessageItem(
    int priority, int timeout, char* msg, 
    void (*cc)(struct FifoMessageItem*), const struct device* dev
) {
    FifoMessageItem_t* fifoItem = k_heap_alloc(&message_item_heap, sizeof(FifoMessageItem_t), K_NO_WAIT);
    fifoItem->dev = dev;
    fifoItem->send = cc;
    fifoItem->message.priority = priority;
    fifoItem->message.sleep_in_ms = timeout;
    strncpy(fifoItem->message.text, msg, sizeof(fifoItem->message.text));

    return fifoItem;
}
```

## src/threads.h
```c
#ifndef THREADS_H
#define THREADS_H

#include <message/message.h>
#include <zephyr.h>
#include <kernel/thread.h>
#include <app_memory/app_memdomain.h>

#define STACKSIZE 512
#define COMMUNICATION_THREAD_PRIORITY 2
#define WORKER_THREAD_PRIORITY -2

/**
 * @brief Identifier of the validation user mode thread.
 * Gets set by threads.c zephyr macro. Used for receiving
 * messages, and forwarding messages to the worker
 * thread.
 */
extern const k_tid_t v1;

extern struct k_mem_partition v1_partition;

/**
 * @brief All incoming messages that gets created as
 * FifoMessageItem_t gets allocated on this heap.
 * 
 */
extern struct k_heap message_item_heap;

/**
 * @brief Heap space for the communication (usermode) thread.
 * 
 */
extern struct k_heap validation_heap;

/**
 * @brief Identifier of the worker kernel mode thread.
 * Gets set by threads.c zephyr macro. Used to process
 * the CAN Messages and send back result to the communication
 * thread.
 */
extern const k_tid_t w1;

/**
 * @brief The identifier for the FIFO from communication to worker thread
 * 
 */
extern struct k_fifo validation_to_worker;

/**
 * @brief The identifier for the FIFO from worker to communication thread
 * 
 */
extern struct k_fifo extern_to_validation;

/**
 * @brief Fifo Message Item
 * 
 * Used to send incoming can messages from the 
 * communication thread to the worker thread.
 */
struct FifoMessageItem 
{
	void *fifo_reserved;  /* First word reserved for use by FIFO */
	message_t message;
	void (*send)(struct FifoMessageItem *message_item);  /* Function Pointer to the specific send function (uart, can, etc.) */
	const struct device* dev;  /* Device which recieved the Message*/
} __packed __aligned(4);
typedef struct FifoMessageItem FifoMessageItem_t;

/**
 * @brief Create a Fifo Message Item object
 * 
 * @param msg The message item
 * @param cc The callback function which sends out the response
 * @param dev The device which recieved the message item
 */
FifoMessageItem_t* createFifoMessageItem(
	int priority, int timeout, char* msg, 
	void (*cc)(struct FifoMessageItem*), const struct device* dev
);

/**
 * @brief 
 * 
 * @param text The pointer to the char array.
 * @param length The length of the char array.
 */
void reverse_in_place(char* text, const size_t length);

#endif /* THREADS_H */
```

## src/usb.c
```c
#include "usb.h"
#include "threads.h"
#include "message/message.h"
#include <stdio.h>
#include <string.h>
#include <device.h>
#include <drivers/uart.h>
#include <zephyr.h>

#include <usb/usb_device.h>
#include <logging/log.h>
LOG_MODULE_REGISTER(cdc_acm_echo);

void send_over_uart(FifoMessageItem_t* fifoItem) {
	union Serialized_Message tx_data;
	tx_data.message = fifoItem->message;
	int ret = uart_tx(fifoItem->dev, tx_data.buffer, sizeof(tx_data.buffer), 1000);
	LOG_DBG("uart_tx returned: %d", ret);
}

static void recieve_to_fifo(const struct device* dev, void* user_data) {
	ARG_UNUSED(user_data);

	/* recive data into buffer after interrupt */
	while (uart_irq_update(dev) && uart_irq_is_pending(dev)) {
		if(uart_irq_rx_ready(dev)) {
			int recv_len;
			union Serialized_Message rx_data;

			recv_len = uart_fifo_read(dev, rx_data.buffer, sizeof(rx_data.buffer));

			/* put into kernel fifo */
			FifoMessageItem_t* fifoItem = createFifoMessageItem(
				rx_data.message.priority,
				rx_data.message.sleep_in_ms,
				rx_data.message.text,
				send_over_uart, dev
			);
			k_fifo_put(&extern_to_validation, fifoItem);

		}
	}
}

int init_usb(void){
    const struct device* dev;
    uint32_t baudrate, dtr = 0u;
    int ret;

    dev = device_get_binding("CDC_ACM_0");
    if(!dev){
        LOG_ERR("CDC ACM device not found\n");
        return -1;
    }

    ret = usb_enable(NULL);
    if(ret != 0){
        LOG_ERR("Failed to enable USB\n");
        return -1;
    }

	LOG_INF("Wait for DTR");
    while(true){
        uart_line_ctrl_get(dev, UART_LINE_CTRL_DTR, &dtr);
        if(dtr) {
            break;
        } else {
            k_sleep(K_MSEC(100));
        }
    }
	LOG_INF("DTR set");

	ret = uart_line_ctrl_set(dev, UART_LINE_CTRL_DCD, 1);
	if(ret) {
		LOG_WRN("Failed to set DCD, ret code %d", ret);
	}

	ret = uart_line_ctrl_set(dev, UART_LINE_CTRL_DSR, 1);
	if(ret) {
		LOG_WRN("Failed to set DSR, ret code %d", ret);
	}

    /* wait for the host to do all settings */
    k_busy_wait(1000000);

	ret = uart_line_ctrl_get(dev, UART_LINE_CTRL_BAUD_RATE, &baudrate);
	if (ret) {
        LOG_WRN("Failed to get baudrate, ret code %d\n", ret);
	} else {
        LOG_INF("Baudrate detected: %d\n", baudrate);
	}

    uart_irq_callback_set(dev, recieve_to_fifo);

    /* enable rx interrupts */
    uart_irq_rx_enable(dev);

	return 0;
}
```

## src/usb.h
```c
int init_usb(void);
```
